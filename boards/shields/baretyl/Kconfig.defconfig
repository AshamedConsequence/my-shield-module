## boards/shields/baretyl/Kconfig.defconfig
```kconfig
if SHIELD_BARETYL_LEFT

# Name must be less than 16 characters long!
config ZMK_KEYBOARD_NAME
    default "baretyl"

config ZMK_SPLIT_ROLE_CENTRAL
    default y


endif

if SHIELD_BARETYL_LEFT || SHIELD_BARETYL_RIGHT

config ZMK_SPLIT
    default y

endif
```

## boards/shields/baretyl/Kconfig.shield
```kconfig
config SHIELD_BARETYL_LEFT
       def_bool $(shields_list_contains,baretyl_left)
config SHIELD_BARETYL_RIGHT
       def_bool $(shields_list_contains,baretyl_right)
```
